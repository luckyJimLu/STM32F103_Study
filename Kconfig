## Kconfig
```kconfig
mainmenu "STM32F103 Product and System Configuration"

source "product/Kconfig"

menu "Operating System (RTOS) Selection"

choice
    prompt "RTOS Mode"
    default RTOS_NONE
    help
        Select real-time operating system kernel or bare-metal mode.

config RTOS_NONE
    bool "Bare-metal (No RTOS)"
    help
        Run application in bare-metal super-loop.

config RTOS_RTTHREAD
    bool "RT-Thread Nano"
    help
        Enable RT-Thread Nano lightweight real-time kernel.

config RTOS_FREERTOS
    bool "FreeRTOS"
    help
        Enable FreeRTOS real-time kernel.

endchoice

endmenu

source "app/Kconfig"
source "bsp/Kconfig"
source "drivers/Kconfig"
source "middlewares/Kconfig"
```

## app/Kconfig
```kconfig
menu "Application Configuration"

config APP_ENABLE_HEARTBEAT
    bool "Enable App LED Heartbeat Task"
    default y
    depends on BSP_USING_LED
    help
        Periodically toggle LED as a heartbeat in application loop.

config APP_LED_BLINK_INTERVAL_MS
    int "Heartbeat Blink Interval (ms)"
    default 500
    range 50 60000
    depends on APP_ENABLE_HEARTBEAT
    help
        Delay interval for LED toggling in milliseconds.

config APP_ENABLE_BUTTON_TASK
    bool "Enable Key/Button Event Polling"
    default y if PRODUCT_ATK_ELITE_F103ZE
    default n
    depends on BSP_USING_KEY
    help
        Poll button state and output messages over serial.

config APP_POLL_INTERVAL_MS
    int "Application polling period (ms)"
    default 10
    range 1 100

config APP_KEY_DEBOUNCE_MS
    int "Button debounce time (ms)"
    default 20
    range 5 200
    depends on APP_ENABLE_BUTTON_TASK

endmenu
```

## bsp/Kconfig
```kconfig
menu "Board Support Package (BSP) Configuration"

config BSP_USING_LED
    bool "Enable On-board LED Driver"
    default y
    depends on DRIVER_HAL_GPIO
    help
        Enable LED GPIO driver (PC13 for BluePill / PB5 for ZET6).

config BSP_USING_KEY
    bool "Enable On-board Key/Button Driver"
    default y if PRODUCT_ATK_ELITE_F103ZE
    default n
    depends on PRODUCT_ATK_ELITE_F103ZE
    depends on DRIVER_HAL_GPIO
    help
        Enable Key input driver.

config BSP_USING_USART1
    bool "Enable USART1 Serial Output (printf retarget)"
    default y
    depends on DRIVER_HAL_UART
    help
        Enable USART1 as standard debugging output port with printf.

config BSP_USART1_BAUDRATE
    int "USART1 Baudrate"
    default 115200
    range 1200 3000000
    depends on BSP_USING_USART1
    help
        Communication baud rate for USART1 (e.g. 115200, 9600).

endmenu
```

## drivers/Kconfig
```kconfig
menu "Drivers & HAL Configuration"

config DRIVER_USE_HAL
    bool
    default y

config DRIVER_HAL_GPIO
    bool
    default y
    depends on DRIVER_USE_HAL

config DRIVER_HAL_UART
    bool
    default y
    depends on DRIVER_USE_HAL

config DRIVER_HAL_RCC
    bool
    default y
    depends on DRIVER_USE_HAL

endmenu
```

## middlewares/Kconfig
```kconfig
source "middlewares/logger/Kconfig"

menu "RTOS Kernel Configuration"

source "middlewares/rtos/rt-thread/Kconfig"
source "middlewares/rtos/freertos/Kconfig"
endmenu
```

## middlewares/logger/Kconfig
```kconfig
menu "Logging Configuration"

config LOG_ENABLE
    bool "Enable serial logger"
    default y
    depends on BSP_USING_USART1
    help
        Enable timestamped, leveled log output through the BSP USART1 console.

config LOG_LEVEL
    int "Maximum log level (0=FATAL, 1=ERROR, 2=WARN, 3=INFO, 4=DEBUG)"
    default 3
    range 0 4
    depends on LOG_ENABLE
    help
        Messages above this level are discarded. INFO is recommended for normal use.

config LOG_BUFFER_SIZE
    int "Log line buffer size"
    default 192
    range 96 512
    depends on LOG_ENABLE
    help
        Maximum formatted log line length, including prefix and line ending.

endmenu
```

## middlewares/rtos/freertos/Kconfig
```kconfig
menu "FreeRTOS Kernel Settings"
    depends on RTOS_FREERTOS

config FREERTOS_TICK_RATE_HZ
    int "Tick Rate (Hz)"
    default 1000
    range 100 2000

config FREERTOS_MAX_PRIORITIES
    int "Maximum Task Priorities"
    default 5
    range 1 32

config FREERTOS_MINIMAL_STACK_SIZE
    int "Minimal Stack Size (words)"
    default 128
    range 64 1024

config FREERTOS_TOTAL_HEAP_SIZE
    int "Total Heap Size (Bytes)"
    default 10240 if PRODUCT_BLUEPILL_F103C8
    default 32768 if PRODUCT_ATK_ELITE_F103ZE
    range 4096 49152

config FREERTOS_APP_TASK_STACK_WORDS
    int "Application task stack size (words)"
    default 256
    range 128 2048

config FREERTOS_APP_TASK_PRIORITY
    int "Application task priority"
    default 2
    range 1 31

config FREERTOS_USE_MUTEXES
    bool "Enable Mutexes"
    default y

config FREERTOS_USE_COUNTING_SEMAPHORES
    bool "Enable Counting Semaphores"
    default y

endmenu
```

## middlewares/rtos/rt-thread/Kconfig
```kconfig
menu "RT-Thread Nano Kernel Settings"
    depends on RTOS_RTTHREAD

config RT_THREAD_PRIORITY_MAX
    int "Max Thread Priority Levels"
    default 32
    range 8 256

config RT_TICK_PER_SECOND
    int "Ticks Per Second (Hz)"
    default 1000
    range 100 2000

config RT_APP_THREAD_STACK_SIZE
    int "Application thread stack size (bytes)"
    default 512
    range 256 4096

config RT_APP_THREAD_PRIORITY
    int "Application thread priority"
    default 10
    range 1 31

config RT_APP_THREAD_TIMESLICE
    int "Application thread timeslice (ticks)"
    default 20
    range 1 100

endmenu
```

## middlewares/third_party/Kconfig
```kconfig
menu "Third-Party Libraries"

config USING_CJSON
    bool "Enable cJSON (Ultralightweight JSON parser in C)"
    default n
    help
        Include cJSON library in build.

config USING_SEGGER_RTT
    bool "Enable SEGGER RTT (Real Time Transfer) Debug Output"
    default n
    help
        Include SEGGER RTT logging system.

endmenu
```

## product/Kconfig
```kconfig
menu "Product Board Selection"

choice
    prompt "Target product"
    default PRODUCT_ATK_ELITE_F103ZE

config PRODUCT_BLUEPILL_F103C8
    bool "BluePill STM32F103C8T6"
    help
        BluePill minimum system board with 64KB Flash and 20KB SRAM.

config PRODUCT_ATK_ELITE_F103ZE
    bool "ALIENTEK Elite STM32F103ZET6"
    help
        ALIENTEK Elite board with 512KB Flash and 64KB SRAM.

endchoice

config MCU_STM32F103XB
    bool
    default y if PRODUCT_BLUEPILL_F103C8

config MCU_STM32F103XE
    bool
    default y if PRODUCT_ATK_ELITE_F103ZE

config ARCH_ARM_CORTEX_M3
    bool
    default y

endmenu
```

## product/atk_elite_f103ze/configs/freertos_defconfig
```kconfig
CONFIG_PRODUCT_ATK_ELITE_F103ZE=y
CONFIG_RTOS_FREERTOS=y
CONFIG_APP_ENABLE_HEARTBEAT=y
CONFIG_APP_LED_BLINK_INTERVAL_MS=500
CONFIG_APP_ENABLE_BUTTON_TASK=y
CONFIG_APP_POLL_INTERVAL_MS=10
CONFIG_APP_KEY_DEBOUNCE_MS=20
CONFIG_BSP_USING_LED=y
CONFIG_BSP_USING_KEY=y
CONFIG_BSP_USING_USART1=y
CONFIG_BSP_USART1_BAUDRATE=115200
CONFIG_LOG_ENABLE=y
CONFIG_LOG_LEVEL=3
CONFIG_LOG_BUFFER_SIZE=192
CONFIG_DRIVER_USE_HAL=y
CONFIG_DRIVER_HAL_GPIO=y
CONFIG_DRIVER_HAL_UART=y
CONFIG_DRIVER_HAL_RCC=y
CONFIG_FREERTOS_TICK_RATE_HZ=1000
CONFIG_FREERTOS_MAX_PRIORITIES=5
CONFIG_FREERTOS_MINIMAL_STACK_SIZE=128
CONFIG_FREERTOS_TOTAL_HEAP_SIZE=32768
CONFIG_FREERTOS_APP_TASK_STACK_WORDS=256
CONFIG_FREERTOS_APP_TASK_PRIORITY=2
CONFIG_FREERTOS_USE_MUTEXES=y
CONFIG_FREERTOS_USE_COUNTING_SEMAPHORES=y
```

## product/atk_elite_f103ze/configs/rtthread_defconfig
```kconfig
CONFIG_PRODUCT_ATK_ELITE_F103ZE=y
CONFIG_RTOS_RTTHREAD=y
CONFIG_APP_ENABLE_HEARTBEAT=y
CONFIG_APP_LED_BLINK_INTERVAL_MS=500
CONFIG_APP_ENABLE_BUTTON_TASK=y
CONFIG_APP_POLL_INTERVAL_MS=10
CONFIG_APP_KEY_DEBOUNCE_MS=20
CONFIG_BSP_USING_LED=y
CONFIG_BSP_USING_KEY=y
CONFIG_BSP_USING_USART1=y
CONFIG_BSP_USART1_BAUDRATE=115200
CONFIG_LOG_ENABLE=y
CONFIG_LOG_LEVEL=3
CONFIG_LOG_BUFFER_SIZE=192
CONFIG_DRIVER_USE_HAL=y
CONFIG_DRIVER_HAL_GPIO=y
CONFIG_DRIVER_HAL_UART=y
CONFIG_DRIVER_HAL_RCC=y
CONFIG_RT_THREAD_PRIORITY_MAX=32
CONFIG_RT_TICK_PER_SECOND=1000
CONFIG_RT_APP_THREAD_STACK_SIZE=1024
CONFIG_RT_APP_THREAD_PRIORITY=10
CONFIG_RT_APP_THREAD_TIMESLICE=20
```

## product/bluepill_f103c8/configs/baremetal_defconfig
```kconfig
CONFIG_PRODUCT_BLUEPILL_F103C8=y
CONFIG_RTOS_NONE=y
CONFIG_APP_ENABLE_HEARTBEAT=y
CONFIG_APP_LED_BLINK_INTERVAL_MS=500
CONFIG_APP_POLL_INTERVAL_MS=10
CONFIG_BSP_USING_LED=y
CONFIG_BSP_USING_USART1=y
CONFIG_BSP_USART1_BAUDRATE=115200
CONFIG_DRIVER_USE_HAL=y
CONFIG_DRIVER_HAL_GPIO=y
CONFIG_DRIVER_HAL_UART=y
CONFIG_DRIVER_HAL_RCC=y
```

## product/bluepill_f103c8/configs/freertos_defconfig
```kconfig
CONFIG_PRODUCT_BLUEPILL_F103C8=y
CONFIG_RTOS_FREERTOS=y
CONFIG_APP_ENABLE_HEARTBEAT=y
CONFIG_APP_LED_BLINK_INTERVAL_MS=500
CONFIG_APP_POLL_INTERVAL_MS=10
CONFIG_BSP_USING_LED=y
CONFIG_BSP_USING_USART1=y
CONFIG_BSP_USART1_BAUDRATE=115200
CONFIG_LOG_ENABLE=y
CONFIG_LOG_LEVEL=3
CONFIG_LOG_BUFFER_SIZE=192
CONFIG_DRIVER_USE_HAL=y
CONFIG_DRIVER_HAL_GPIO=y
CONFIG_DRIVER_HAL_UART=y
CONFIG_DRIVER_HAL_RCC=y
CONFIG_FREERTOS_TICK_RATE_HZ=1000
CONFIG_FREERTOS_MAX_PRIORITIES=5
CONFIG_FREERTOS_MINIMAL_STACK_SIZE=128
CONFIG_FREERTOS_TOTAL_HEAP_SIZE=10240
CONFIG_FREERTOS_APP_TASK_STACK_WORDS=256
CONFIG_FREERTOS_APP_TASK_PRIORITY=2
CONFIG_FREERTOS_USE_MUTEXES=y
CONFIG_FREERTOS_USE_COUNTING_SEMAPHORES=y
```

## third_party/Kconfig
```kconfig
menu "Third-Party Libraries & Repositories"

config THIRD_PARTY_USE_LIBS
    bool "Enable Third-Party Libraries Layer"
    default y

if THIRD_PARTY_USE_LIBS

source "third_party/cJSON/Kconfig"
source "third_party/lwip/Kconfig"
source "third_party/segger_rtt/Kconfig"
source "third_party/easylogger/Kconfig"
source "third_party/letter_shell/Kconfig"

endif

endmenu
```

## third_party/cJSON/Kconfig
```kconfig
config USING_CJSON
    bool "Enable cJSON (Lightweight JSON Parser)"
    default n
    help
        Include cJSON library for parsing and generating JSON data.
```

## third_party/easylogger/Kconfig
```kconfig
config USING_EASYLOGGER
    bool "Enable EasyLogger (Ultra-lightweight Logging Library)"
    default n
    help
        Include EasyLogger lightweight and high performance logging library.
```

## third_party/letter_shell/Kconfig
```kconfig
config USING_LETTER_SHELL
    bool "Enable Letter Shell (Interactive Embedded Shell)"
    default n
    help
        Include Letter Shell for command line interaction over serial UART.
```

## third_party/lwip/Kconfig
```kconfig
config USING_LWIP
    bool "Enable LwIP (Lightweight TCP/IP Stack)"
    default n
    help
        Include LwIP network protocol stack for ethernet/WiFi devices (ENC28J60, W5500, LAN8720).

if USING_LWIP

config LWIP_USING_DHCP
    bool "Enable DHCP Client"
    default y

config LWIP_USING_DNS
    bool "Enable DNS Client"
    default y

config LWIP_MEM_SIZE
    int "LwIP Heap Memory Size (Bytes)"
    default 4096

endif
```

## third_party/segger_rtt/Kconfig
```kconfig
config USING_SEGGER_RTT
    bool "Enable SEGGER RTT (Real Time Transfer Log)"
    default n
    help
        Include SEGGER RTT debug channel. Transmit logs at ultra-high speed via SWD/JTAG without occupying UART pins.
```
